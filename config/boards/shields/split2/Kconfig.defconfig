## config/boards/shields/split2/Kconfig.defconfig
```kconfig
if SHIELD_SPLIT2_LEFT

config ZMK_KEYBOARD_NAME
    default "SPLIT2"

config ZMK_SPLIT_ROLE_CENTRAL
    default y

endif

if SHIELD_SPLIT2_LEFT || SHIELD_SPLIT2_RIGHT

config ZMK_SPLIT
    default y

endif
```

## config/boards/shields/split2/Kconfig.shield
```kconfig
config SHIELD_SPLIT2_LEFT
    def_bool $(shields_list_contains,split2_left)

config SHIELD_SPLIT2_RIGHT
    def_bool $(shields_list_contains,split2_right)
```
